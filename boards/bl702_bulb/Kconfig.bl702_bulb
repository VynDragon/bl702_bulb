## boards/bl702_bulb/Kconfig.bl702_bulb
```kconfig
# SPDX-FileCopyrightText: Copyright The Zephyr Project Contributors
# SPDX-License-Identifier: Apache-2.0

config BOARD_BL702_BULB
	select SOC_BL702C10Q2H

if BOARD_BL702_BULB

endif
```

## boards/bl702_bulb/bl702_bulb_defconfig
```kconfig
# SPDX-FileCopyrightText: Copyright The Zephyr Project Contributors
# SPDX-License-Identifier: Apache-2.0

CONFIG_GPIO=y
CONFIG_CONSOLE=y
CONFIG_SERIAL=y
CONFIG_UART_CONSOLE=y
CONFIG_SECURE_STORAGE_ITS_TRANSFORM_AEAD_KEY_PROVIDER_ENTRY_UID_HASH=y
CONFIG_MBEDTLS_AES_ROM_TABLES=y
```

## boards/bl702_bulb/board.yml
```yaml
board:
  name: bl702_bulb
  full_name: BL702 Bulb
  vendor: others
  socs:
    - name: bl702c10q2h
```

## west.yml
```yaml
manifest:
  remotes:
    - name: zephyrproject-rtos
      url-base: https://github.com/zephyrproject-rtos
    - name: project-chip
      url-base: https://github.com/project-chip

  projects:
    - name: zephyr
      remote: zephyrproject-rtos
      revision: main
      import:
        name-allowlist:
          - hal_bouffalolab
          - openthread
          - mbedtls
          - tf-psa-crypto
    - name: matter
      url: https://github.com/project-chip/connectedhomeip
      revision: master
      path: modules/lib/matter
      submodules:
        - path: third_party/editline/repo
        - path: third_party/jsoncpp/repo
        - path: third_party/nlassert/repo
        - path: third_party/nlio/repo
        - path: third_party/uriparser/repo
        - path: third_party/pigweed/repo
```
